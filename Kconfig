## Kconfig
```kconfig
##menu "操作系统作业" 
choice 
	prompt "选择实验"
	config EXPER1
		bool "第一次实验"
	config EXPER2
		bool "第二次实验"
#
#	config EXPER1
#		bool "mutex experiment"
#    
#    config EXPER1
#		bool "mutex experiment"

	help 
		"to choice experiment which will be compile and run"
endchoice

##endmenu
```

## e1/src/Kconfig
```kconfig
##menu "操作系统作业" 
choice 
	prompt "实验"
	config E1
		bool "process experiment"

	config E2
		bool "mutex experiment"

	help 
		"to choice experiment which will be compile and run"
endchoice

##endmenu
```

## e2/Kconfig
```kconfig
##menu "操作系统作业" 
choice 
	prompt "实验"
	config E1
		bool "内存管理"

	config E2
		bool "内存置换"

	help 
		"to choice experiment which will be compile and run"
endchoice

##endmenu
```
